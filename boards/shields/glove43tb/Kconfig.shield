## boards/shields/glove43tb/Kconfig.shield
```kconfig
config SHIELD_GLOVE43TB_R
    def_bool $(shields_list_contains,glove43tb_R)

config SHIELD_GLOVE43TB_L
    def_bool $(shields_list_contains,glove43tb_L)

config SHIELD_GLOVE43TB_DONGLE
    def_bool $(shields_list_contains,glove43tb_dongle)
```

## config/west.yml
```yaml
manifest:
  remotes:
    - name: zmkfirmware
      url-base: https://github.com/zmkfirmware
    - name: keebkuro
      url-base: https://github.com/keebkuro
    - name: caksoylar
      url-base: https://github.com/caksoylar
    - name: badjeff
      url-base: https://github.com/badjeff
    - name: rschenk
      url-base: https://github.com/rschenk
  projects:
    - name: zmk
      remote: zmkfirmware
      revision: v0.3
      import: app/west.yml
    - name: zmk-pmw3610-driver
      remote: badjeff
      revision: main
    - name: zmk-rgbled-widget
      remote: caksoylar
      revision: main
    - name: zmk-component-raytac-dongle
      remote: rschenk
      revision: main
  self:
    path: config
```
